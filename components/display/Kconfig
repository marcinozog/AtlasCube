## components/display/Kconfig
```kconfig
menu "Display configuration"

choice DISPLAY_TYPE
    prompt "Select display driver"
    default DISPLAY_ILI9341

config DISPLAY_ILI9341
    bool "ILI9341"

config DISPLAY_ST7796
    bool "ST7796"

config DISPLAY_SSD1322
    bool "SSD1322"

endchoice

endmenu
```

## components/mqtt_svc/Kconfig
```kconfig
menu "MQTT configuration"

config MQTT_ENABLE
    bool "Enable MQTT client"
    default y
    help
        Build and link the MQTT client component. When disabled,
        mqtt_svc_* calls compile to no-ops and the runtime settings tab
        is hidden / inactive. Use this to shrink the firmware when MQTT
        is not needed.

endmenu
```

## components/touch/Kconfig
```kconfig
menu "Touch configuration"

choice TOUCH_TYPE
    prompt "Select touch driver"
    default TOUCH_CST816D

config TOUCH_CST816D
    bool "CST816D"

config TOUCH_FT6336U
    bool "FT6336U"

config TOUCH_NONE
    bool "None (no touch — e.g. mono OLED driven by encoder)"

endchoice

# Touch orientation (swap_xy, mirror_x, mirror_y) is defined per UI_PROFILE_*
# in components/ui/ui_profile.h — not exposed here.

endmenu
```

## main/Kconfig.projbuild
```kconfig
menu "Board selection"

choice BOARD_TYPE
    prompt "Select hardware board"
    default BOARD_ATLASCUBE
    help
        Choose the target hardware board. The active selection must match
        the #define BOARD_* in main/include/defines.h.
        CMakeLists.txt reads defines.h and writes CONFIG_BOARD_* into
        build/sdkconfig.variant automatically — do not edit sdkconfig directly.

config BOARD_ATLASCUBE
    bool "AtlasCube (ESP32-S3)"
    help
        Original AtlasCube board with ST7796 / ILI9341 display,
        FT6336U touch, PCM5102A passive DAC and optional BT module.

config BOARD_ES3C28P
    bool "ES3C28P (2.8-inch ESP32-S3 Display Module)"
    help
        Waveshare-style 2.8-inch ESP32-S3 display module (QD2833 SPI LCD,
        FT6336U touch on I2C, ES8311 audio codec, WS2812B RGB LED,
        MicroSD slot and integrated LiPo charger).

endchoice

endmenu
```
