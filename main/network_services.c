#include "network_services.h"

#include "defines.h"
#include "esp_log.h"
#include "wifi_manager.h"
#include "mdns_service.h"
#include "ntp_service.h"
#include "weather.h"
#include "mqtt_svc.h"
#include "espnow_link.h"
#include "radio_service.h"
#include "updater.h"
#include "net_wallpaper_sched.h"
#include "settings.h"
#include "ui_manager.h"
#include "ui_profile.h"   // DISPLAY_WIDTH/HEIGHT for the wallpaper scheduler
#include "freertos/FreeRTOS.h"
#include "freertos/semphr.h"

// Stamp of the web UI this app was built with (generated by compress_web.py) —
// handed to the updater's www staleness check. Same guarded include + fallback
// as http_server.c: absent on a raw idf.py build, then the check is skipped.
#if defined(__has_include)
#  if __has_include("web_assets_version.h")
#    include "web_assets_version.h"
#  endif
#endif
#ifndef WEB_ASSETS_VERSION
#define WEB_ASSETS_VERSION "unknown"
#endif

static const char *TAG = "NETSVC";

static bool s_started      = false;   // one-shot: the services below are not restartable
static bool s_booted_in_ap = false;   // boot ended without a link → the WiFi screen is showing

// on_connected() can be entered from two tasks at once: app_main during
// network_services_start() and the WiFi supervisor firing the link callback at
// the same moment. Without this, both could pass the s_started check and start
// mDNS/MQTT twice.
static SemaphoreHandle_t s_lock = NULL;

static void on_connected(void)
{
    if (s_lock) xSemaphoreTake(s_lock, portMAX_DELAY);

    // ESP-NOW peers remember the interface they were added on, so a late AP→STA
    // transition has to be followed here or the pilot goes quiet. Cheap and safe
    // on every link-up, including plain reconnects.
    espnow_link_rebind();

    if (!s_started) {
        s_started = true;
        app_settings_t *s = settings_get();

        ntp_service_init();
        // ntp_service_init() only applies hardcoded defaults; re-apply the saved
        // servers + timezone so they survive a restart (see ntp_service.h tip).
        ntp_service_reconfigure(s->ntp.server1, s->ntp.server2, s->ntp.tz);
        weather_init();
        mdns_service_start();   // <hostname>.local — STA only (AP IP is fixed)
        mqtt_svc_init();        // esp-mqtt owns its own reconnect loop from here

        // Auto-update: background check. Firmware version first; when it's
        // current, the same task compares the web-UI stamp locally (an app-only
        // update never rewrites the www partition). The check ALWAYS runs (its
        // server check-in is how device usage is counted); settings.update.enable
        // only gates whether the SCREEN_UPDATE prompt is shown — that gate lives
        // in the UI notify callback (ui_manager on_update_available).
        updater_start(app_fw_variant(), WEB_ASSETS_VERSION);

        // Internet-wallpaper auto refresh (needs internet; daily mode needs NTP).
        // Arms its one-shot only when the feature is enabled in settings.
        net_wallpaper_sched_init(DISPLAY_WIDTH, DISPLAY_HEIGHT);

        // Opt-in via playlist.resume_on_boot.
        radio_resume_on_boot();

        ESP_LOGI(TAG, "online services started");
    } else {
        // Reconnect. NTP, MQTT, weather and the radio each carry their own retry
        // logic, so there is deliberately nothing to restart here — starting
        // them again would just duplicate tasks.
        ESP_LOGI(TAG, "link back, services already running");
    }

    // Boot ended in AP mode, so the device is sitting on the WiFi setup screen.
    // Now that it is online, leave it. Only on the first successful connect — a
    // later reconnect must not yank the user off whatever they were looking at.
    if (s_booted_in_ap) {
        s_booted_in_ap = false;
        ESP_LOGI(TAG, "leaving the WiFi setup screen");
        ui_navigate(settings_get()->display.screen);
    }

    if (s_lock) xSemaphoreGive(s_lock);
}

static void on_link_change(bool up)
{
    if (up) on_connected();
    else    ESP_LOGW(TAG, "offline — waiting for the link to come back");
}

void network_services_start(void)
{
    s_booted_in_ap = (wifi_get_run_mode() != WIFI_RUN_MODE_STA);
    if (!s_lock) s_lock = xSemaphoreCreateMutex();

    wifi_manager_set_link_cb(on_link_change);

    // The boot-time link-up happens inside wifi_init(), long before this point,
    // so the callback alone would never fire for it. Registering first and then
    // checking closes the window where the supervisor connects in between; the
    // s_started guard makes the possible double call a no-op.
    if (wifi_is_connected()) on_connected();
}
